## board/qualcomm/ipq807x/kernel_fdt.its
```
/*
 * Simple U-Boot uImage source file containing a single kernel and FDT blob
 */

/dts-v1/;

/ {
	description = "IPQ807x kernel and FDT blob";
	#address-cells = <1>;

	images {
		kernel {
			description = "IPQ807x Linux kernel";
			data = /incbin/("Image.gz");
			type = "kernel";
			arch = "arm64";
			os = "linux";
			compression = "gzip";
			load = <0x41000000>;
			entry = <0x41000000>;
			hash-1 {
				algo = "crc32";
			};
			hash-2 {
				algo = "sha1";
			};
		};
		fdt-1 {
			description = "Flattened Device Tree blob";
			data = /incbin/("ipq8072-301w.dtb");
			type = "flat_dt";
			arch = "arm64";
			compression = "none";
			hash-1 {
				algo = "crc32";
			};
			hash-2 {
				algo = "sha1";
			};
		};
	};

	configurations {
		default = "conf-1";
		conf-1 {
			description = "Boot Linux kernel with FDT blob";
			kernel = "kernel";
			fdt = "fdt-1";
		};
	};
};
```

## board/qualcomm/ipq807x/qnap_301w_defconfig
```kconfig
BR2_aarch64=y
BR2_TOOLCHAIN_EXTERNAL=y
BR2_TOOLCHAIN_EXTERNAL_BOOTLIN=y
BR2_ROOTFS_DEVICE_CREATION_DYNAMIC_EUDEV=y
BR2_ROOTFS_POST_IMAGE_SCRIPT="$(BR2_EXTERNAL_IPQ807X_PATH)/board/qualcomm/ipq807x/post-build.sh"
BR2_LINUX_KERNEL=y
BR2_LINUX_KERNEL_CUSTOM_GIT=y
BR2_LINUX_KERNEL_CUSTOM_REPO_URL="https://github.com/robimarko/linux.git"
BR2_LINUX_KERNEL_CUSTOM_REPO_VERSION="f4799ef88bc8f99a56d59d0b6eb496b9409f1ba1"
BR2_LINUX_KERNEL_USE_CUSTOM_CONFIG=y
BR2_LINUX_KERNEL_CUSTOM_CONFIG_FILE="$(BR2_EXTERNAL_IPQ807X_PATH)/board/qualcomm/ipq807x/linux.config"
BR2_LINUX_KERNEL_IMAGEGZ=y
BR2_LINUX_KERNEL_DTS_SUPPORT=y
BR2_LINUX_KERNEL_INTREE_DTS_NAME="qcom/ipq8072-301w"
BR2_PACKAGE_BUSYBOX_SHOW_OTHERS=y
BR2_PACKAGE_BUSYBOX_WATCHDOG=y
BR2_PACKAGE_E2FSPROGS=y
BR2_PACKAGE_MTD=y
BR2_PACKAGE_USBUTILS=y
BR2_PACKAGE_IW=y
BR2_PACKAGE_WIRELESS_REGDB=y
BR2_PACKAGE_KMOD_TOOLS=y
BR2_TARGET_ROOTFS_CPIO_ZSTD=y
BR2_TARGET_ROOTFS_INITRAMFS=y
BR2_PACKAGE_HOST_UBOOT_TOOLS=y
BR2_PACKAGE_HOST_UBOOT_TOOLS_FIT_SUPPORT=y
BR2_PACKAGE_ATH11K_FIRMWARE=y
BR2_PACKAGE_ATH11K_FIRMWARE_IPQ8074=y
```

## configs/ipq807x_defconfig
```kconfig
BR2_aarch64=y
BR2_TOOLCHAIN_EXTERNAL=y
BR2_TOOLCHAIN_EXTERNAL_BOOTLIN=y
BR2_ROOTFS_DEVICE_CREATION_DYNAMIC_EUDEV=y
BR2_ROOTFS_OVERLAY="$(BR2_EXTERNAL_IPQ807X_PATH)/files"
BR2_ROOTFS_POST_IMAGE_SCRIPT="$(BR2_EXTERNAL_IPQ807X_PATH)/board/qualcomm/ipq807x/post-build.sh"
BR2_LINUX_KERNEL=y
BR2_LINUX_KERNEL_CUSTOM_GIT=y
BR2_LINUX_KERNEL_CUSTOM_REPO_URL="https://github.com/robimarko/linux.git"
BR2_LINUX_KERNEL_CUSTOM_REPO_VERSION="3229abe59351eb7bfb3e670b078ce54fda40a03c"
BR2_LINUX_KERNEL_USE_CUSTOM_CONFIG=y
BR2_LINUX_KERNEL_CUSTOM_CONFIG_FILE="$(BR2_EXTERNAL_IPQ807X_PATH)/board/qualcomm/ipq807x/linux.config"
BR2_LINUX_KERNEL_IMAGEGZ=y
BR2_LINUX_KERNEL_DTS_SUPPORT=y
BR2_LINUX_KERNEL_INTREE_DTS_NAME="qcom/ipq8072-301w"
BR2_PACKAGE_BUSYBOX_SHOW_OTHERS=y
BR2_PACKAGE_BUSYBOX_WATCHDOG=y
BR2_PACKAGE_MBW=y
BR2_PACKAGE_E2FSPROGS=y
BR2_PACKAGE_MTD=y
BR2_PACKAGE_MDIO_TOOLS=y
BR2_PACKAGE_PCIUTILS=y
BR2_PACKAGE_USBUTILS=y
BR2_PACKAGE_LIBGPIOD=y
BR2_PACKAGE_LIBGPIOD_TOOLS=y
BR2_PACKAGE_DROPBEAR=y
BR2_PACKAGE_ETHTOOL=y
BR2_PACKAGE_HOSTAPD=y
# BR2_PACKAGE_HOSTAPD_DRIVER_HOSTAP is not set
BR2_PACKAGE_HOSTAPD_WPA3=y
BR2_PACKAGE_IPROUTE2=y
BR2_PACKAGE_IW=y
BR2_PACKAGE_NTP=y
BR2_PACKAGE_WGET=y
BR2_PACKAGE_WIRELESS_REGDB=y
BR2_PACKAGE_KMOD_TOOLS=y
BR2_PACKAGE_UTIL_LINUX_HWCLOCK=y
BR2_TARGET_ROOTFS_CPIO_ZSTD=y
BR2_TARGET_ROOTFS_INITRAMFS=y
BR2_PACKAGE_HOST_UBOOT_TOOLS=y
BR2_PACKAGE_HOST_UBOOT_TOOLS_FIT_SUPPORT=y
BR2_PACKAGE_ATH11K_FIRMWARE=y
BR2_PACKAGE_ATH11K_FIRMWARE_IPQ8074=y
BR2_PACKAGE_ATH11K_FIRMWARE_QCN9074=y
BR2_PACKAGE_ATH11K_BDF=y
BR2_PACKAGE_MHZ=y
BR2_PACKAGE_QCA_SSDK=y
BR2_PACKAGE_QCA_SSDK_SHELL=y
BR2_PACKAGE_QCA_NSS_DP=y
BR2_PACKAGE_AQ_FW_DOWNLOAD=y
BR2_PACKAGE_QRTR=y
```

## package/aq-fw-download/Config.in
```kconfig
config BR2_PACKAGE_AQ_FW_DOWNLOAD
	bool "Aquantia FW downloader utitlity"
	select BR2_PACKAGE_LIBBSD
	help
	  Aquantia FW downloader utitlity
```

## package/ath11k-bdf/Config.in
```kconfig
config BR2_PACKAGE_ATH11K_BDF
	bool "ath11k-bdf"
	help
	  This package enables access to BDF required for
	  ath11k supported devices to operate.

if BR2_PACKAGE_ATH11K_BDF

choice
	prompt "Target board"

config BR2_PACKAGE_ATH11K_BDF_301W
	bool "Qnap 301W BDF"
	help
	  BDF file for Qnap 301W.

config BR2_PACKAGE_ATH11K_BDF_AX9000
	bool "Xiaomi AX9000 BDF"
	help
	  BDF file for Xiaomi AX9000.

endchoice

endif
```

## package/ath11k-firmware/Config.in
```kconfig
config BR2_PACKAGE_ATH11K_FIRMWARE
	bool "ath11k-firmware"
	help
	  This package enables access to firmware required for
	  ath11k supported devices to operate.

if BR2_PACKAGE_ATH11K_FIRMWARE

config BR2_PACKAGE_ATH11K_FIRMWARE_IPQ8074
	bool "IPQ8074 firmware"
	help
	  Firmware files for IPQ807x SoC series.

endif
```

## package/mbw/Config.in
```kconfig
config BR2_PACKAGE_MBW
	bool "Memory Bandwidth Benchmark"
	help
	  MBW determines the "copy" memory bandwidth
	  available to userspace programs.
```

## package/mdio-tools/Config.in
```kconfig
comment "mdio-tools needs a Linux kernel to be built"
	depends on !BR2_LINUX_KERNEL

config BR2_PACKAGE_MDIO_TOOLS
	bool "mdio-tools"
	depends on BR2_LINUX_KERNEL
	select BR2_PACKAGE_LIBMNL
	help
	  Low-level debug tools for MDIO devices
```

## package/mhz/Config.in
```kconfig
config BR2_PACKAGE_MHZ
	bool "CPU frequency measurement utility"
	help
	  CPU frequency measurement utility
```

## package/qca-nss-dp/Config.in
```kconfig
comment "NSS-DP needs a Linux kernel to be built"
	depends on !BR2_LINUX_KERNEL

config BR2_PACKAGE_QCA_NSS_DP
	bool "Qualcomm NSS-DP"
	depends on BR2_LINUX_KERNEL
	depends on BR2_PACKAGE_QCA_SSDK
	help
	  This package provides Qualcomm NSS dataplane ethernet driver for Qualcom SoCs.
```

## package/qca-ssdk-shell/Config.in
```kconfig
config BR2_PACKAGE_QCA_SSDK_SHELL
	bool "Qualcomm SSDK shell"
	depends on BR2_PACKAGE_QCA_SSDK
	select BR2_PACKAGE_LIBBSD
	help
	  This package provides Qualcomm SSDK shell for debugging.
```

## package/qca-ssdk/Config.in
```kconfig
comment "SSDK needs a Linux kernel to be built"
	depends on !BR2_LINUX_KERNEL

config BR2_PACKAGE_QCA_SSDK
	bool "Qualcomm SSDK"
	depends on BR2_LINUX_KERNEL
	help
	  This package provides Qualcomm SSDK which is a switch/PHY driver
	  for Qualcomm SoC-s.
```

## package/qrtr/Config.in
```kconfig
config BR2_PACKAGE_QRTR
	bool "Qualcomm QRTR tools"
	help
	  Tools for debugging QRTR
```
